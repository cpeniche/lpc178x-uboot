## arch/arm/mach-lpc/Kconfig
```kconfig
if ARCH_LPC

config LPC178
	bool "lpc178 family"
	select CLK
	select DM_TIMER
	
source "arch/arm/mach-lpc/lpc178/Kconfig"

endif
```

## arch/arm/mach-lpc/lpc178/Kconfig
```kconfig
if LPC178

config TARGET_LPC1788_LANDTIGER
	bool "LPC1788 LandTiger board"

source "board/nxp/lpc1788-landtiger/Kconfig"

endif
```

## board/nxp/lpc1788-landtiger/Kconfig
```kconfig
if TARGET_LPC1788_LANDTIGER

config SYS_BOARD
	string
	default "lpc1788-landtiger"

config SYS_VENDOR
	string
	default "nxp"

config SYS_SOC
	string
	default "lpc178"

config SYS_CONFIG_NAME
	string
	default "lpc1788-landtiger"

endif
```
